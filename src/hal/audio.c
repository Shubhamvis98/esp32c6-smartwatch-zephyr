/**
 * @file hal/audio.c
 * @brief ES8311 codec (slave, I2S Philips, 16-bit) driven by the ESP32-C6 I2S
 *        master at 16 kHz with MCLK = 256·fs = 4.096 MHz, full duplex:
 *
 *   speaker  ← DSDIN  ← I2S TX ← audio task (beeps, WAV playback)
 *   mic      → ASDOUT → I2S RX → mic task  (level meter, optional sink)
 *
 * Register sequence follows Espressif's es8311 component (esp-bsp), which
 * uses the legacy I2C driver and so can't share our i2c_master bus.
 */

#include "hal/audio.h"
#include "hal/i2c_bus.h"
#include "pinout.h"

#include <math.h>
#include <stdbool.h>
#include <stdio.h>
#include <string.h>
#include "esp_attr.h"
#include "esp_log.h"
#include <zephyr/drivers/i2s.h>
#include "freertos/FreeRTOS.h"
#include "freertos/queue.h"
#include "freertos/task.h"

static const char *TAG = "audio";

#define AUDIO_CHUNK_FRAMES  256
#define AUDIO_AMPLITUDE     12000      // of 32767 — leaves headroom for the amp

/* DMA: 8 × 320 frames = 160 ms per direction, so the mic survives short
 * stalls (e.g. flash erases while recording) */
#define AUDIO_DMA_DESC      8
#define AUDIO_DMA_FRAMES    320
#define MIC_BLOCK_FRAMES    320            // 20 ms analysis window

/* Microphone: analog MIC1P, PGA +30 dB, +30 dB digital.  At +18 dB digital
 * a beep from the speaker next to the mic still only peaked at -37 dBFS,
 * so recordings played back almost silent. */
#define ES_MIC_PGA          0x1A
#define ES_MIC_ADC_SCALE    0x05           // +30 dB digital (6 dB steps)
#define ES_MIC_ADC_VOLUME   0xBF           // 0 dB
#define ES_I2C_TIMEOUT_MS   50

/* ES8311 registers */
#define ES_REG00_RESET      0x00
#define ES_REG01_CLK        0x01
#define ES_REG02_CLK        0x02
#define ES_REG03_CLK        0x03
#define ES_REG04_CLK        0x04
#define ES_REG05_CLK        0x05
#define ES_REG06_CLK        0x06
#define ES_REG07_CLK        0x07
#define ES_REG08_CLK        0x08
#define ES_REG09_SDPIN      0x09
#define ES_REG0A_SDPOUT     0x0A
#define ES_REG0B_SYSTEM     0x0B
#define ES_REG0C_SYSTEM     0x0C
#define ES_REG10_SYSTEM     0x10
#define ES_REG11_SYSTEM     0x11
#define ES_REG0D_SYSTEM     0x0D
#define ES_REG0E_SYSTEM     0x0E
#define ES_REG12_SYSTEM     0x12
#define ES_REG13_SYSTEM     0x13
#define ES_REG14_SYSTEM     0x14
#define ES_REG16_ADC        0x16
#define ES_REG15_ADC        0x15
#define ES_REG17_ADC        0x17
#define ES_REG1B_ADC        0x1B
#define ES_REG44_GPIO       0x44
#define ES_REG45_GP         0x45
#define ES_REG1C_ADC        0x1C
#define ES_REG31_DAC        0x31
#define ES_REG32_DAC_VOL    0x32
#define ES_REG37_DAC        0x37
#define ES_REGFD_CHIP_ID1   0xFD

typedef enum { REQ_NONE, REQ_BEEP, REQ_WAV } req_kind_t;

typedef struct {
    req_kind_t kind;
    uint16_t   freq_hz;
    uint16_t   on_ms;
    uint16_t   off_ms;
    uint8_t    repeat;
    char       path[48];        // REQ_WAV
} beep_req_t;

static i2c_master_dev_handle_t s_dev = NULL;
/* I2S on Zephyr: one controller, TX and RX share BCK/WS (generated by TX),
 * so TX keeps running (with silence) while the microphone is on. */
static const struct device *const s_i2s = DEVICE_DT_GET(DT_NODELABEL(i2s));
#define I2S_BLOCK_FRAMES    320                                   /* 20 ms */
#define I2S_BLOCK_BYTES     (I2S_BLOCK_FRAMES * 2 * sizeof(int16_t))
K_MEM_SLAB_DEFINE_STATIC(s_tx_slab, I2S_BLOCK_BYTES, 4, 4);
K_MEM_SLAB_DEFINE_STATIC(s_rx_slab, I2S_BLOCK_BYTES, 4, 4);
static bool                    s_i2s_ok;
static volatile bool           s_tx_running;
static int16_t                 s_tx_acc[I2S_BLOCK_FRAMES * 2];    /* partial block */
static size_t                  s_tx_acc_frames;
static volatile bool           s_playing = false;

/* Microphone */
static TaskHandle_t            s_mic_task;
static volatile bool           s_mic_on;
static StreamBufferHandle_t    s_mic_sink;
static volatile float          s_mic_rms_dbfs = -96.0f;
static volatile float          s_mic_peak_dbfs = -96.0f;
static volatile uint32_t       s_mic_dropped;
static QueueHandle_t           s_queue = NULL;
static volatile bool           s_stop = false;
static volatile bool           s_paused = false;

static esp_err_t es_write(uint8_t reg, uint8_t val)
{
    uint8_t buf[2] = { reg, val };
    return i2c_master_transmit(s_dev, buf, sizeof(buf), ES_I2C_TIMEOUT_MS);
}

static esp_err_t es_read(uint8_t reg, uint8_t *val)
{
    return i2c_master_transmit_receive(s_dev, &reg, 1, val, 1, ES_I2C_TIMEOUT_MS);
}

static void es_mute(bool mute)
{
    uint8_t r;
    if (es_read(ES_REG31_DAC, &r) != ESP_OK) return;
    if (mute) r |= (1 << 6) | (1 << 5);
    else      r &= ~((1 << 6) | (1 << 5));
    es_write(ES_REG31_DAC, r);
}

static esp_err_t es8311_init(void)
{
    uint8_t id;
    esp_err_t err = es_read(ES_REGFD_CHIP_ID1, &id);
    if (err != ESP_OK) {
        ESP_LOGE(TAG, "ES8311 not responding: %s", esp_err_to_name(err));
        return err;
    }

    /* Better I2C noise immunity; written twice because the first write
     * after power-up is sometimes lost (as in Espressif's esp_codec_dev) */
    es_write(ES_REG44_GPIO, 0x08);
    es_write(ES_REG44_GPIO, 0x08);

    /* Reset, then power-on command */
    es_write(ES_REG00_RESET, 0x1F);
    vTaskDelay(pdMS_TO_TICKS(20));
    es_write(ES_REG00_RESET, 0x00);
    es_write(ES_REG00_RESET, 0x80);    // slave mode (bit 6 = 0), power on

    /* Clocks: all on, MCLK from MCLK pin, not inverted; SCLK not inverted */
    es_write(ES_REG01_CLK, 0x3F);
    uint8_t r;
    es_read(ES_REG06_CLK, &r);
    r &= ~(1 << 5);
    es_write(ES_REG06_CLK, r);

    /* Dividers for MCLK 4.096 MHz / fs 16 kHz:
     * pre_div=1 pre_multi=x1 adc_div=1 dac_div=1 fs_mode=single
     * lrck=0x00FF bclk_div=4 adc_osr=0x10 dac_osr=0x10 */
    es_read(ES_REG02_CLK, &r);
    es_write(ES_REG02_CLK, r & 0x07);
    es_write(ES_REG03_CLK, 0x10);
    es_write(ES_REG04_CLK, 0x10);
    es_write(ES_REG05_CLK, 0x00);
    es_read(ES_REG06_CLK, &r);
    es_write(ES_REG06_CLK, (r & 0xE0) | (4 - 1));
    es_read(ES_REG07_CLK, &r);
    es_write(ES_REG07_CLK, r & 0xC0);
    es_write(ES_REG08_CLK, 0xFF);

    /* Power up the analog references and bias.  Without these the ADC
     * output stays at near-zero noise. */
    es_write(ES_REG0B_SYSTEM, 0x00);
    es_write(ES_REG0C_SYSTEM, 0x00);
    es_write(ES_REG10_SYSTEM, 0x1F);
    es_write(ES_REG11_SYSTEM, 0x7F);

    /* Serial port: I2S, 16-bit in and out */
    es_write(ES_REG09_SDPIN,  3 << 2);
    es_write(ES_REG0A_SDPOUT, 3 << 2);

    /* Analog power-up, DAC on, output to HP driver, bypass EQs */
    es_write(ES_REG0D_SYSTEM, 0x01);
    es_write(ES_REG0E_SYSTEM, 0x02);
    es_write(ES_REG12_SYSTEM, 0x00);
    es_write(ES_REG13_SYSTEM, 0x10);
    es_write(ES_REG1B_ADC,    0x0A);   // ADC high-pass filter
    es_write(ES_REG1C_ADC,    0x6A);   // EQ bypass, cancel DC offset
    es_write(ES_REG15_ADC,    0x40);   // ADC ramp rate
    es_write(ES_REG45_GP,     0x00);
    err = es_write(ES_REG37_DAC, 0x08);

    /* Microphone path */
    es_write(ES_REG14_SYSTEM, ES_MIC_PGA);
    es_write(ES_REG16_ADC,    ES_MIC_ADC_SCALE);
    es_write(ES_REG17_ADC,    ES_MIC_ADC_VOLUME);

    es_mute(true);
    return err;
}


static esp_err_t i2s_init(void)
{
    if (!device_is_ready(s_i2s)) return ESP_ERR_INVALID_STATE;
    struct i2s_config cfg = {
        .word_size      = 16,
        .channels       = 2,
        .format         = I2S_FMT_DATA_FORMAT_I2S,
        .options        = I2S_OPT_BIT_CLK_CONTROLLER | I2S_OPT_FRAME_CLK_CONTROLLER,
        .frame_clk_freq = AUDIO_SAMPLE_RATE,
        .block_size     = I2S_BLOCK_BYTES,
        .timeout        = 1000,
    };
    /* TX first: RX configured after it follows TX's BCK/WS (like IDF duplex) */
    cfg.mem_slab = &s_tx_slab;
    int r = i2s_configure(s_i2s, I2S_DIR_TX, &cfg);
    cfg.mem_slab = &s_rx_slab;
    if (r == 0) r = i2s_configure(s_i2s, I2S_DIR_RX, &cfg);
    if (r != 0) {
        ESP_LOGE(TAG, "i2s_configure: %d", r);
        return ESP_FAIL;
    }
    s_i2s_ok = true;
    return ESP_OK;
}

/* Like the ESP-IDF version (TX always on, sending silence), the stream runs
 * all the time: TX+RX together, because RX takes its clocks from TX and the
 * ESP32 I2S driver has one state for the controller.  The audio task feeds
 * TX (silence when idle) and the mic task drains RX.  Only the audio task
 * starts or restarts the stream. */
static const enum i2s_dir s_dir = I2S_DIR_BOTH;
static int16_t s_silence[I2S_BLOCK_FRAMES * 2];
static volatile uint32_t s_restarts;
/* Set by the mic task when RX stopped (DMA overflow while it was starved).
 * TX can keep running in that state, so tx_block() would never notice; the
 * audio task restarts the stream on its next block. */
static volatile bool s_rx_restart;

static void stream_start(void)
{
    i2s_trigger(s_i2s, s_dir, I2S_TRIGGER_DROP);
    i2s_trigger(s_i2s, s_dir, I2S_TRIGGER_PREPARE);
    s_tx_running = false;
    for (int i = 0; i < 2; i++) {
        void *blk;
        if (k_mem_slab_alloc(&s_tx_slab, &blk, K_NO_WAIT) != 0) break;
        memset(blk, 0, I2S_BLOCK_BYTES);
        if (i2s_write(s_i2s, blk, I2S_BLOCK_BYTES) != 0) k_mem_slab_free(&s_tx_slab, blk);
    }
    if (i2s_trigger(s_i2s, s_dir, I2S_TRIGGER_START) == 0) s_tx_running = true;
    s_restarts++;
}

/* Queue one full block (waits for a free one, which paces us to the DMA).
 * Not i2s_buf_write(): it waits forever for a slab block, which never comes
 * if the stream stopped with the queue full. */
static void tx_block(const int16_t *stereo)
{
    if (s_rx_restart) {
        s_rx_restart = false;
        stream_start();
    }
    void *blk;
    bool ok = s_tx_running && k_mem_slab_alloc(&s_tx_slab, &blk, K_MSEC(200)) == 0;
    if (ok) {
        memcpy(blk, stereo, I2S_BLOCK_BYTES);
        if (i2s_write(s_i2s, blk, I2S_BLOCK_BYTES) != 0) {
            k_mem_slab_free(&s_tx_slab, blk);
            ok = false;
        }
    }
    if (!ok) {
        stream_start();                   /* underrun, RX overflow or not started */
        k_msleep(5);
    }
}

/* Write stereo frames, cutting them into I2S blocks. */
static void tx_write(const int16_t *stereo, size_t frames)
{
    while (frames) {
        size_t n = MIN(frames, I2S_BLOCK_FRAMES - s_tx_acc_frames);
        memcpy(&s_tx_acc[2 * s_tx_acc_frames], stereo, n * 2 * sizeof(int16_t));
        s_tx_acc_frames += n;
        stereo += 2 * n;
        frames -= n;
        if (s_tx_acc_frames == I2S_BLOCK_FRAMES) {
            tx_block(s_tx_acc);
            s_tx_acc_frames = 0;
        }
    }
}

/* Pad the last partial block with silence and send it */
static void tx_flush(void)
{
    if (!s_tx_acc_frames) return;
    memset(&s_tx_acc[2 * s_tx_acc_frames], 0, (I2S_BLOCK_FRAMES - s_tx_acc_frames) * 2 * sizeof(int16_t));
    tx_block(s_tx_acc);
    s_tx_acc_frames = 0;
}



/* Write `frames` stereo frames of a sine (or silence if freq == 0) */
static void play_segment(uint16_t freq_hz, uint32_t frames)
{
    static int16_t buf[AUDIO_CHUNK_FRAMES * 2];
    static float phase = 0;
    const float step = 2.0f * (float)M_PI * freq_hz / AUDIO_SAMPLE_RATE;

    while (frames > 0 && !s_stop) {
        uint32_t n = frames < AUDIO_CHUNK_FRAMES ? frames : AUDIO_CHUNK_FRAMES;
        for (uint32_t i = 0; i < n; i++) {
            int16_t s = 0;
            if (freq_hz) {
                s = (int16_t)(AUDIO_AMPLITUDE * sinf(phase));
                phase += step;
                if (phase > 2.0f * (float)M_PI) phase -= 2.0f * (float)M_PI;
            }
            buf[2 * i] = buf[2 * i + 1] = s;
        }
        tx_write(buf, n);
        frames -= n;
    }
    phase = 0;
}

/* Play a 16 kHz 16-bit mono WAV (as written by the recorder) */
/* Playback gain that brings the file's peak to WAV_TARGET_PEAK, at most
 * WAV_MAX_GAIN (so near-silent files aren't turned into loud hiss). */
#define WAV_TARGET_PEAK   (32767 * 7 / 10)     // about -3 dBFS
#define WAV_MAX_GAIN      16

static int32_t wav_gain_q8(FILE *f)
{
    static int16_t buf[AUDIO_CHUNK_FRAMES];
    int32_t peak = 0;
    size_t n;
    while ((n = fread(buf, sizeof(int16_t), AUDIO_CHUNK_FRAMES, f)) > 0) {
        for (size_t i = 0; i < n; i++) {
            int32_t v = buf[i] < 0 ? -(int32_t)buf[i] : buf[i];
            if (v > peak) peak = v;
        }
    }
    if (peak == 0) return 256;
    int32_t g = (int32_t)WAV_TARGET_PEAK * 256 / peak;
    if (g > WAV_MAX_GAIN * 256) g = WAV_MAX_GAIN * 256;
    return g < 256 ? 256 : g;
}

static void play_wav(const char *path)
{
    FILE *f = fopen(path, "rb");
    if (!f) {
        ESP_LOGW(TAG, "Cannot open %s", path);
        return;
    }
    fseek(f, AUDIO_WAV_HEADER_SIZE, SEEK_SET);
    int32_t gain = wav_gain_q8(f);
    fseek(f, AUDIO_WAV_HEADER_SIZE, SEEK_SET);
    ESP_LOGI(TAG, "Playing %s (gain x%ld.%02ld)", path, (long)(gain / 256), (long)(gain % 256 * 100 / 256));

    static int16_t mono[AUDIO_CHUNK_FRAMES];
    static int16_t stereo[AUDIO_CHUNK_FRAMES * 2];
    size_t n;
    for (;;) {
        /* Paused: hold the file position, muted (TX auto-clear sends silence).
         * Any new request (alarm, beep, other clip) ends the paused clip. */
        if (s_paused) {
            es_mute(true);
            while (s_paused && !s_stop && uxQueueMessagesWaiting(s_queue) == 0) {
                tx_block(s_silence);
            }
            if (s_paused) break;
            es_mute(false);
        }
        if (s_stop || (n = fread(mono, sizeof(int16_t), AUDIO_CHUNK_FRAMES, f)) == 0) break;
        for (size_t i = 0; i < n; i++) {
            int32_t v = (int32_t)mono[i] * gain / 256;
            if (v > 32767) v = 32767;
            if (v < -32768) v = -32768;
            stereo[2 * i] = stereo[2 * i + 1] = (int16_t)v;
        }
        tx_write(stereo, n);
    }
    fclose(f);
}

static void audio_task(void *arg)
{
    beep_req_t req;
    stream_start();
    for (;;) {
        if (xQueueReceive(s_queue, &req, 0) != pdTRUE) {
            tx_block(s_silence);           /* idle: keep the clocks (and the mic) running */
            continue;
        }
        if (req.kind == REQ_NONE) continue;
        s_stop = false;
        s_paused = false;
        s_playing = true;
        es_mute(false);
        if (req.kind == REQ_WAV) {
            play_wav(req.path);
        } else {
            for (int i = 0; i < req.repeat && !s_stop; i++) {
                play_segment(req.freq_hz, (uint32_t)AUDIO_SAMPLE_RATE * req.on_ms / 1000);
                play_segment(0, (uint32_t)AUDIO_SAMPLE_RATE * req.off_ms / 1000);
            }
        }
        /* Let the DMA drain before muting */
        play_segment(0, AUDIO_SAMPLE_RATE / 20);
        tx_flush();
        if (uxQueueMessagesWaiting(s_queue) == 0) {
            es_mute(true);
            s_playing = false;
        }
    }
}

/* ── Microphone ──────────────────────────────────────────────────────────── */
/* RX DMA ran out of buffers: samples were lost before the mic task saw them */

static float to_dbfs(float v)
{
    return v > 0.5f ? 20.0f * log10f(v / 32768.0f) : -96.0f;
}

static void mic_task(void *arg)
{
    static int16_t stereo[MIC_BLOCK_FRAMES * 2];
    static int16_t mono[MIC_BLOCK_FRAMES];

    for (;;) {
        size_t got = 0;
        if (i2s_buf_read(s_i2s, stereo, &got) != 0) {
            s_rx_restart = true;
            k_msleep(5);                                   // stream (re)starting
            continue;
        }
        if (!s_mic_on) {                                   // RX always runs: drop the block
            s_mic_rms_dbfs = s_mic_peak_dbfs = -96.0f;
            continue;
        }
        size_t frames = got / (2 * sizeof(int16_t));
        if (!frames) continue;
        /* ES8311 puts the ADC on the left slot */
        int64_t sum = 0;
        for (size_t i = 0; i < frames; i++) {
            mono[i] = stereo[2 * i];
            sum += mono[i];
        }
        float mean = (float)sum / frames;                  // remove DC
        double acc = 0;
        float peak = 0;
        for (size_t i = 0; i < frames; i++) {
            float v = mono[i] - mean;
            acc += (double)v * v;
            if (fabsf(v) > peak) peak = fabsf(v);
        }
        s_mic_rms_dbfs = to_dbfs(sqrtf((float)(acc / frames)));
        s_mic_peak_dbfs = to_dbfs(peak);
        StreamBufferHandle_t sink = s_mic_sink;
        if (sink) {
            size_t bytes = frames * sizeof(int16_t);
            if (xStreamBufferSend(sink, mono, bytes, 0) != bytes) s_mic_dropped += frames;
        }
    }
}

esp_err_t audio_mic_start(StreamBufferHandle_t sink)
{
    if (!s_i2s_ok) return ESP_ERR_INVALID_STATE;
    if (s_mic_on) return ESP_ERR_INVALID_STATE;          // one user at a time
    s_mic_sink = sink;
    s_mic_dropped = 0;
    s_mic_on = true;
    return ESP_OK;
}

void audio_mic_stop(void)
{
    if (!s_mic_on) return;
    s_mic_on = false;
    vTaskDelay(pdMS_TO_TICKS(60));                       // let the mic task finish its block
    s_mic_sink = NULL;
}

bool audio_mic_active(void)         { return s_mic_on; }
float audio_mic_rms_dbfs(void)      { return s_mic_rms_dbfs; }
float audio_mic_peak_dbfs(void)     { return s_mic_peak_dbfs; }
uint32_t audio_mic_dropped(void)    { return s_mic_dropped; }

esp_err_t audio_init(void)
{
    esp_err_t err = i2c_bus_add_device(I2C_ADDR_ES8311, I2C_BUS_SPEED_HZ, &s_dev);
    if (err != ESP_OK) return err;

    /* I2S first: the ES8311 needs MCLK running while it is configured */
    err = i2s_init();
    if (err != ESP_OK) {
        ESP_LOGE(TAG, "I2S init failed: %s", esp_err_to_name(err));
        return err;
    }
    err = es8311_init();
    if (err != ESP_OK) return err;

    s_queue = xQueueCreate(4, sizeof(beep_req_t));
    if (!s_queue) return ESP_ERR_NO_MEM;
    if (xTaskCreate(audio_task, "audio", 3072, NULL, 3, NULL) != pdPASS) {
        return ESP_ERR_NO_MEM;
    }
    /* Above the recorder's writer so samples are never late */
    if (xTaskCreate(mic_task, "mic", 2048, NULL, 6, &s_mic_task) != pdPASS) {
        return ESP_ERR_NO_MEM;
    }

    ESP_LOGI(TAG, "ES8311 ready (16 kHz, 16-bit)");
    return ESP_OK;
}

void audio_set_volume(uint8_t volume)
{
    if (!s_dev) return;
    if (volume > 100) volume = 100;
    /* 0xBF = 0 dB; the scale is 0.5 dB/step.  Map 1–100 % onto −47.5…0 dB. */
    uint8_t reg = volume ? (uint8_t)(0x60 + (0xBF - 0x60) * volume / 100) : 0;
    es_write(ES_REG32_DAC_VOL, reg);
}

void audio_beep(uint16_t freq_hz, uint16_t on_ms, uint16_t off_ms, uint8_t repeat)
{
    if (!s_queue) return;
    beep_req_t req = { .kind = REQ_BEEP, .freq_hz = freq_hz, .on_ms = on_ms,
                       .off_ms = off_ms, .repeat = repeat };
    xQueueSend(s_queue, &req, 0);
}

void audio_stop(void)
{
    if (!s_queue) return;
    xQueueReset(s_queue);
    s_stop = true;
    s_paused = false;
}

void audio_pause(bool pause)
{
    s_paused = pause && s_playing;
}

bool audio_is_paused(void)
{
    return s_paused;
}

void audio_play_wav(const char *path)
{
    if (!s_queue) return;
    audio_stop();
    beep_req_t req = { .kind = REQ_WAV };
    strlcpy(req.path, path, sizeof(req.path));
    xQueueSend(s_queue, &req, 0);
}

bool audio_is_playing(void)
{
    return s_playing || uxQueueMessagesWaiting(s_queue) > 0;
}

/* Debug: I2S stream state for the "watch audio" shell command */
void audio_debug(char *buf, size_t len)
{
    int n0 = 0;

    snprintf(buf, len, "running=%d restarts=%u mic=%d playing=%d tx_slab_used=%u rx_slab_used=%u",
             s_tx_running, s_restarts, s_mic_on, s_playing,
             k_mem_slab_num_used_get(&s_tx_slab), k_mem_slab_num_used_get(&s_rx_slab));
}
